## Config.in
```kconfig
source "$NERVES_DEFCONFIG_DIR/package/python-attrs2/Config.in"
source "$NERVES_DEFCONFIG_DIR/package/python-jsonschema2/Config.in"
source "$NERVES_DEFCONFIG_DIR/package/python-jsonschema-specifications2/Config.in"
source "$NERVES_DEFCONFIG_DIR/package/python-referencing2/Config.in"
source "$NERVES_DEFCONFIG_DIR/package/python-rpds-py2/Config.in"
source "$NERVES_DEFCONFIG_DIR/package/python-yamllint2/Config.in"
source "$NERVES_DEFCONFIG_DIR/package/ti-k3-boot-firmware-next/Config.in"
source "$NERVES_DEFCONFIG_DIR/package/ti-k3-r5-loader-next/Config.in"
source "$NERVES_DEFCONFIG_DIR/package/ti-k3-secdev/Config.in"

source "$BR2_EXTERNAL_REDWIRE_PACKAGES_PATH/Config.in"
```

## package/python-attrs2/Config.in
```kconfig
config BR2_PACKAGE_PYTHON_ATTRS2
	bool "python-attrs2"
	help
	  attrs is the Python package that will bring back the joy of
	  writing classes by relieving you from the drudgery of
	  implementing object protocols (aka dunder methods).

	  https://attrs.readthedocs.io/
```

## package/python-referencing2/Config.in
```kconfig
config BR2_PACKAGE_PYTHON_REFERENCING2
	bool "python-referencing2"
	depends on BR2_PACKAGE_HOST_RUSTC_TARGET_ARCH_SUPPORTS # python-rpds-py
	select BR2_PACKAGE_PYTHON_ATTRS # runtime
	select BR2_PACKAGE_PYTHON_RPDS_PY # runtime
	help
	  JSON Referencing + Python.

	  https://github.com/python-jsonschema/referencing
```

## package/python-rpds-py2/Config.in
```kconfig
config BR2_PACKAGE_PYTHON_RPDS_PY2
	bool "python-rpds-py2"
	depends on BR2_PACKAGE_HOST_RUSTC_TARGET_ARCH_SUPPORTS
	help
	  Python bindings to the Rust rpds crate for persistent
	  data structures.

	  https://github.com/crate-py/rpds
```

## package/python-yamllint2/Config.in
```kconfig
config BR2_PACKAGE_PYTHON_YAMLLINT2
	bool "python-yamllint2"
	select BR2_PACKAGE_PYTHON_PATHSPEC # runtime
	select BR2_PACKAGE_PYTHON_PYYAML # runtime
	help
	  A linter for YAML files.

	  https://github.com/adrienverge/yamllint
```

## package/ti-k3-image-gen/Config.in
```kconfig
config BR2_PACKAGE_TI_K3_IMAGE_GEN
	bool "ti-k3-image-gen"
	depends on BR2_PACKAGE_TI_K3_R5_LOADER_NEXT
	help
	  System Firmware (SYSFW) and Configuration Image Generator TI K3 Family
	  SoCs.

	  https://git.ti.com/cgit/k3-image-gen/k3-image-gen/

if BR2_PACKAGE_TI_K3_IMAGE_GEN
choice
	prompt "SoC firmware type for image gen"
	default BR2_PACKAGE_TI_K3_IMAGE_GEN_FW_TYPE_TIFS

config BR2_PACKAGE_TI_K3_IMAGE_GEN_FW_TYPE_TIFS
	bool "Firmware type TIFS"

config BR2_PACKAGE_TI_K3_IMAGE_GEN_FW_TYPE_TISCI
	bool "Firmware type TISCI"

endchoice

config BR2_PACKAGE_TI_K3_IMAGE_GEN_SOC
	string "SoC"
	help
	  Supported target SoC. Example: am62x

config BR2_PACKAGE_TI_K3_IMAGE_GEN_SOC_TYPE
	string "security type"
	help

	  "gp" General Purpose devices
	  "hs-fs" High Security - Field Securable devices
	  "hs" High Security - Security Enforcing devices

	  **Note**: for all High Security device variants the environment variable
	  **TI_SECURE_DEV_PKG** should be defined to point to the TI Secure
	  Development Tools package. This will be used for setting the **KEY**
	  and **SW_REV** values. See:

	  https://git.ti.com/cgit/security-development-tools/core-secdev-k3

config BR2_PACKAGE_TI_K3_IMAGE_GEN_CONFIG
	string "config type"
	help
	  "sk" or "evm"
endif
```
